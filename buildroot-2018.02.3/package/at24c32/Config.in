## buildroot-2018.02.3/package/at24c32/Config.in
```kconfig
config BR2_PACKAGE_AT24C32
	bool "at24c32"
	depends on BR2_LINUX_KERNEL
	help
	  at24c32 wifi driver


comment "at24c32 needs a Linux kernel to be built"
	depends on !BR2_LINUX_KERNEL
```
